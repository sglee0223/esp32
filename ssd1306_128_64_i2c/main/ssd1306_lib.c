
#include <stdio.h>
#include "driver/i2c.h"
#include "driver/gpio.h"

#include "ssd1306_lib.h"

/* 6x8 font */
static uint8_t ssd1306_font[] = {
	0x00, 0x00, 0x00, 0x00, 0x00, 0x00,
	0x00, 0x00, 0x5F, 0x00, 0x00, 0x00,
	0x00, 0x00, 0x07, 0x00, 0x07, 0x00,
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	0x00, 0x02, 0x05, 0x05, 0x02, 0x00, /* degree symbol */
};

int ssd1306_write_cmd(uint8_t cmd)
{
    i2c_cmd_handle_t hCmd = i2c_cmd_link_create();
    i2c_master_start(hCmd);
    i2c_master_write_byte(hCmd, ( SSD1306_I2C_ADDR << 1 ) | WRITE_BIT, ACK_CHECK_EN);
    i2c_master_write_byte(hCmd, 0x00, ACK_CHECK_EN);
    i2c_master_write_byte(hCmd, cmd, ACK_CHECK_EN);
    i2c_master_stop(hCmd);
    esp_err_t ret = i2c_master_cmd_begin(I2C_MASTER_NUM, hCmd, 10 / portTICK_RATE_MS);
    i2c_cmd_link_delete(hCmd);

    if (ret != ESP_OK)
        printf("ssd1306_write_cmd Error [0x%x]\n", cmd);
    return ret;
}

int ssd1306_write_data(uint8_t data[], int len)
{
    i2c_cmd_handle_t hCmd = i2c_cmd_link_create();
    i2c_master_start(hCmd);
    i2c_master_write_byte(hCmd, ( SSD1306_I2C_ADDR << 1 ) | WRITE_BIT, ACK_CHECK_EN);
    i2c_master_write_byte(hCmd, 0x40, ACK_CHECK_EN);
    i2c_master_write(hCmd, data, len, ACK_CHECK_EN);
    i2c_master_stop(hCmd);
    esp_err_t ret = i2c_master_cmd_begin(I2C_MASTER_NUM, hCmd, 10 / portTICK_RATE_MS);
    i2c_cmd_link_delete(hCmd);

    if (ret != ESP_OK)
        printf("ssd1306_write_data Error [0x%x]\n", data[0]);

    return ret;
}

int ssd1306_write_cmdNdata(uint8_t cmd, uint8_t data)
{
    i2c_cmd_handle_t hCmd = i2c_cmd_link_create();
    i2c_master_start(hCmd);
    i2c_master_write_byte(hCmd, ( SSD1306_I2C_ADDR << 1 ) | WRITE_BIT, ACK_CHECK_EN);
    i2c_master_write_byte(hCmd, 0x00, ACK_CHECK_EN);
    i2c_master_write_byte(hCmd, cmd, ACK_CHECK_EN);
    i2c_master_write_byte(hCmd, 0x40, ACK_CHECK_EN);
    i2c_master_write_byte(hCmd, data, ACK_CHECK_EN);
    i2c_master_stop(hCmd);
    esp_err_t ret = i2c_master_cmd_begin(I2C_MASTER_NUM, hCmd, 10 / portTICK_RATE_MS);
    i2c_cmd_link_delete(hCmd);

    if (ret != ESP_OK)
        printf("ssd1306_write_cmdNdata Error [0x%x]\n", cmd);
    return ret;
}

int ssd1306_set_address(uint8_t x, uint8_t y)
{
	ssd1306_write_cmd(SSD1306_CMD_SET_COLUMN_ADDR);
	ssd1306_write_cmd(x);
	ssd1306_write_cmd(SSD1306_LCD_WIDTH - 1);
	ssd1306_write_cmd(SSD1306_CMD_SET_PAGE_ADDR);
	ssd1306_write_cmd(y);
	ssd1306_write_cmd((SSD1306_LCD_HEIGHT / 8) - 1);

	return 0;
}

int ssd1306_set_cursor(uint8_t row, uint8_t column)
{
	if (row > (SSD1306_LCD_HEIGHT / 8) - 1) return 1;
	if (column > (SSD1306_LCD_WIDTH / 6) - 1) return 1;
	ssd1306_set_address(column * 6, row);

	return 0;
}

int ssd1306_clear()
{
	uint8_t row, column, buffer[8] = {0, 0, 0, 0, 0, 0, 0, 0};

	ssd1306_write_cmd(SSD1306_CMD_DISPLAY_OFF);

	for (row = 0; row < SSD1306_LCD_HEIGHT / 8; row++) {
		ssd1306_set_address(0, row);
		for (column = 0; column < SSD1306_LCD_WIDTH; column += 8) {
			/* Clear the display - 8x8 pixels at the time */
			ssd1306_write_data(buffer, 8);
		}
	}

	ssd1306_write_cmd(SSD1306_CMD_DISPLAY_ON);

	return 0;
}

int ssd1306_putc(uint8_t c)
{
	if (c < 32 || c > 127) c = ' ';

	ssd1306_write_data(&ssd1306_font[((c - 32) * 6)], 6);

	return 0;
}

int ssd1306_puts(char string[])
{
	int i = 0;
	while (string[i] != '\0') {
		ssd1306_putc(string[i]);
		i++;
	}

	return 0;
}

int ssd1306_init(void)
{
	unsigned int i;
	uint8_t init_cmd_sequence[] = {
		SSD1306_CMD_DISPLAY_OFF,	/* switch display off */
		SSD1306_CMD_SET_CLK_DIV,	/* set clock divisor */
		0x80,
		SSD1306_CMD_SET_MUX,		/* set mux ratio */
		(SSD1306_LCD_HEIGHT-1),		/* 39 */
		SSD1306_CMD_SET_OFFSET,		/* set display offset */
		0x00,
		SSD1306_CMD_SET_START_LINE,	/* set start line */
		SSD1306_CMD_SET_CHARGEPUMP,	/* set charge pump */
		0x14,				/* enable charge pump */
		SSD1306_CMD_SET_COM_SCAN_INC,	/* set COM scan direction */
		SSD1306_CMD_SET_COM_PINS,	/* set COM pins configuratio */
		0x12,
		SSD1306_CMD_SET_CONTRAST,	/* set contrast */
		0xAF,
		SSD1306_CMD_SET_PRECHARGE,	/* set pre-charge */
		0x25,
		SSD1306_CMD_SET_VCOM_DESELECT,	/* set VCOM deselect level */
		0x20,
		SSD1306_CMD_DISPLAY_ALL_ON_RES,	/* set entire display on */
		SSD1306_CMD_NORMAL,		/* set normal display mode */
		SSD1306_CMD_DISPLAY_ON		/* switch display on */
	};

    printf("ssd1306_init begin\n");

	for (i = 0; i < sizeof(init_cmd_sequence); i++)
		ssd1306_write_cmd(init_cmd_sequence[i]);

	/* 100ms delay */
	vTaskDelay(100 / portTICK_RATE_MS);

	ssd1306_clear();

    printf("ssd1306_init end\n");

	return 0;
}

void ssd1306_i2c_init(void)
{
    printf("ssd1306_i2c_init begin\n");

    int i2c_master_port = I2C_MASTER_NUM;
    i2c_config_t conf;
    conf.mode = I2C_MODE_MASTER;
    conf.sda_io_num = SSD1306_GPIO_SDA;
    conf.sda_pullup_en = GPIO_PULLUP_ENABLE;
    conf.scl_io_num = SSD1306_GPIO_SCL;
    conf.scl_pullup_en = GPIO_PULLUP_ENABLE;
    conf.master.clk_speed = I2C_MASTER_FREQ_HZ;
    i2c_param_config(i2c_master_port, &conf);
    i2c_driver_install(i2c_master_port, conf.mode,
                       I2C_MASTER_RX_BUF_DISABLE,
                       I2C_MASTER_TX_BUF_DISABLE, 0);

    printf("ssd1306_i2c_init end\n");
}

void ssd1306_reset(void)
{
	/* reset SSD1306 */
    gpio_pad_select_gpio(SSD1306_GPIO_RST);
    gpio_set_direction(SSD1306_GPIO_RST, GPIO_MODE_OUTPUT);

    gpio_set_level(SSD1306_GPIO_RST, 1);
    vTaskDelay(1 / portTICK_RATE_MS);
	gpio_set_level(SSD1306_GPIO_RST, 0);
	vTaskDelay(10 / portTICK_RATE_MS);  /* 10ms reset LOW delay */
	gpio_set_level(SSD1306_GPIO_RST, 1);
	vTaskDelay(1 / portTICK_RATE_MS);	/* 5us reset HIGH delay */
}

void ssd1306_i2c_scan(void)
{
	char info[] = "Scanning I2C bus...\r\n";

	printf("%s", info);

	for(uint16_t i = 0; i < 128; i++)
	{
        i2c_cmd_handle_t hCmd = i2c_cmd_link_create();
        i2c_master_start(hCmd);
        i2c_master_write_byte(hCmd, ( i << 1 ) | WRITE_BIT, ACK_CHECK_EN);
        i2c_master_write_byte(hCmd, 0x00, ACK_CHECK_EN);
        i2c_master_write_byte(hCmd, 0xE3, ACK_CHECK_EN);    // Command for no operation
        i2c_master_stop(hCmd);
        esp_err_t ret = i2c_master_cmd_begin(I2C_MASTER_NUM, hCmd, 10 / portTICK_RATE_MS);
        i2c_cmd_link_delete(hCmd);

		if(ret == ESP_OK)
		{
    		char msg[64];

    		snprintf(msg, sizeof(msg), "0x%02X", i);
    		printf("%s", msg);
		}
        else
		{
			printf("%s", ".");
		}
	}

	printf("%s", "\r\n");
}

